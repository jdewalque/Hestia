## CMakeLists.txt
```
cmake_minimum_required(VERSION 3.20)

find_package(Zephyr REQUIRED HINTS $ENV{ZEPHYR_BASE})
project(hestia)

target_sources(app PRIVATE
  src/main.c
  src/alert.c
  src/alert_json.c
  src/battery.c
  src/config.c
  src/config_json.c
  src/link.c
  src/net.c
  src/position.c
  src/text.c
  src/ui.c
)
```

## prj.conf
```kconfig
# --- Système -----------------------------------------------------------------
CONFIG_TFM_PROFILE_TYPE_MINIMAL=y
# La partie sécurisée (TF-M) se tait et libère UART1, utilisé pour nos journaux.
CONFIG_TFM_LOG_LEVEL_SILENCE=y
CONFIG_TFM_SECURE_UART=n
CONFIG_FPU=y
CONFIG_REBOOT=y
CONFIG_MAIN_STACK_SIZE=4096
CONFIG_SYSTEM_WORKQUEUE_STACK_SIZE=2048
CONFIG_HEAP_MEM_POOL_SIZE=24576
CONFIG_HEAP_MEM_POOL_IGNORE_MIN=y

CONFIG_LOG=y
CONFIG_LOG_MODE_DEFERRED=y

# --- Liaison avec l'application (UART0 <-> Bluetooth via le nRF5340) ---------
CONFIG_UART_INTERRUPT_DRIVEN=y
CONFIG_CJSON_LIB=y

# --- Réglages conservés en mémoire flash -------------------------------------
CONFIG_FLASH=y
CONFIG_FLASH_MAP=y
CONFIG_NVS=y
CONFIG_SETTINGS=y
CONFIG_SETTINGS_NVS=y

# --- Modem, LTE et SMS -------------------------------------------------------
CONFIG_NRF_MODEM_LIB=y
CONFIG_LTE_LINK_CONTROL=y
CONFIG_LTE_LC_PSM_MODULE=y
CONFIG_LTE_PSM_REQ=y
CONFIG_LTE_PSM_REQ_RPTAU="00101000"
CONFIG_LTE_PSM_REQ_RAT="00000100"
CONFIG_AT_MONITOR_HEAP_SIZE=4096
CONFIG_SMS=y
CONFIG_MODEM_INFO=y
CONFIG_MODEM_INFO_ADD_NETWORK=y
CONFIG_DATE_TIME=y
CONFIG_MODEM_JWT=y

CONFIG_NETWORKING=y
CONFIG_NET_SOCKETS=y
CONFIG_NET_SOCKETS_OFFLOAD=y

# --- nRF Cloud (conversion Wi-Fi / antennes -> coordonnées, alertes) ----------
CONFIG_NRF_CLOUD=y
CONFIG_NRF_CLOUD_COAP=y
CONFIG_COAP_CLIENT_BLOCK_SIZE=1024
CONFIG_COAP_CLIENT_STACK_SIZE=2048
CONFIG_COAP_CLIENT_THREAD_PRIORITY=0

# --- Localisation ------------------------------------------------------------
CONFIG_LOCATION=y
# Pas de GPS : trop lent et rarement utilisable en intérieur.
CONFIG_LOCATION_METHOD_GNSS=n
CONFIG_LOCATION_METHOD_CELLULAR=y
CONFIG_LOCATION_METHOD_WIFI=y
# Les relevés (bornes Wi-Fi, antennes) nous sont confiés au lieu de partir
# aussitôt vers nRF Cloud : le bijou les garde en mémoire et ne les fait
# convertir en position qu'au moment d'une alerte (src/position.c).
CONFIG_LOCATION_SERVICE_NRF_CLOUD=n
CONFIG_LOCATION_SERVICE_EXTERNAL=y
CONFIG_LOCATION_METHOD_WIFI_SCANNING_RESULTS_MAX_CNT=20
```

## src/main.c
```c
/*
 * Hestia — firmware du bijou d'urgence (prototype sur Thingy:91 X, nRF9151).
 *
 * Un appui maintenu sur le bouton localise le bijou (Wi-Fi, puis antennes)
 * et envoie un SMS avec la position aux contacts choisis dans l'application.
 * Entre deux alertes, le bijou mémorise les bornes et antennes alentour, pour
 * donner la dernière position connue s'il ne trouve rien au moment de l'alerte.
 */
#include <zephyr/kernel.h>
#include <zephyr/logging/log.h>

#include "alert.h"
#include "config.h"
#include "link.h"
#include "net.h"
#include "position.h"
#include "ui.h"

LOG_MODULE_REGISTER(main, LOG_LEVEL_INF);

int main(void)
{
	LOG_INF("Hestia démarre");

	/* Chaque module signale lui-même ses erreurs. On continue malgré un
	 * échec pour garder un maximum de fonctions : par exemple, les réglages
	 * restent modifiables même si le modem ne démarre pas.
	 */
	(void)ui_init();
	(void)config_init();
	(void)link_init();

	if (net_init() == 0) {
		(void)alert_init();
		(void)position_init();
	}

	/* Ouvre la session nRF Cloud dès que le réseau est là, pour que la
	 * première alerte n'ait pas à le faire.
	 */
	if (net_wait_connected(K_FOREVER)) {
		(void)net_cloud_ensure();
	}
	return 0;
}
```

## src/alert.c
```c
#include <errno.h>

#include <zephyr/kernel.h>
#include <zephyr/logging/log.h>

#include <cJSON.h>
#include <cJSON_os.h>
#include <date_time.h>
#include <modem/sms.h>
#include <net/nrf_cloud_coap.h>
#include <nrf_modem_at.h>

#include "alert.h"
#include "alert_json.h"
#include "battery.h"
#include "config.h"
#include "link.h"
#include "net.h"
#include "position.h"
#include "text.h"
#include "ui.h"

LOG_MODULE_REGISTER(alert, LOG_LEVEL_INF);

/* Attente maximale du réseau mobile avant d'abandonner une alerte. Après un
 * allumage, le bijou met couramment plus d'une minute à trouver le réseau.
 */
#define NETWORK_WAIT K_SECONDS(120)

struct alert_request {
	bool test;
	int reply_id;
};

K_MSGQ_DEFINE(requests, sizeof(struct alert_request), 1, 4);

static atomic_t busy;
static struct text_position position_buf;

/* Tampons de travail : trop gros pour la pile, et une seule alerte à la fois. */
static struct hestia_config cfg;
static char sms_utf8[TEXT_SMS_LEN];
static char sms_latin9[TEXT_SMS_LEN];

/* Code « délai réseau dépassé » du modem (+CMS ERROR: 332). */
#define CMS_NETWORK_TIMEOUT 332

/*
 * Envoie le texte de sms_utf8 à tous les contacts, directement par le modem.
 * Retourne le nombre de SMS partis.
 *
 * Tous les réseaux n'acheminent pas les SMS (en NB-IoT notamment) : c'est
 * pourquoi l'alerte part aussi vers nRF Cloud, voir send_to_cloud().
 */
static int send_sms_to_all(void)
{
	int sent = 0;

	text_utf8_to_latin9(sms_latin9, sizeof(sms_latin9), sms_utf8);

	for (int i = 0; i < cfg.contact_count; i++) {
		int err = sms_send_text(cfg.contacts[i].phone, sms_latin9);

		if (err == 0) {
			LOG_INF("SMS au contact %d : envoyé", i + 1);
			sent++;
			continue;
		}
		LOG_ERR("SMS au contact %d : échec (%d)", i + 1, err);

		/* Chaque essai sans réponse du réseau dure une trentaine de
		 * secondes et les suivants échoueraient de la même façon.
		 */
		if (err > 0 && nrf_modem_at_err_type(err) == NRF_MODEM_AT_CMS_ERROR &&
		    nrf_modem_at_err(err) == CMS_NETWORK_TIMEOUT) {
			LOG_WRN("Le réseau n'achemine pas les SMS : abandon des suivants");
			break;
		}
	}
	return sent;
}

/* Envoie l'alerte à nRF Cloud. Retourne 0 si nRF Cloud l'a bien reçue. */
static int send_to_cloud(enum alert_kind kind, const struct text_position *position)
{
	int64_t now_ms = 0;
	cJSON *msg;
	char *text;
	int err;

	err = net_cloud_ensure();
	if (err) {
		return err;
	}

	(void)date_time_now(&now_ms);
	msg = alert_json_build(kind, &cfg, position, battery_percent(), now_ms);
	text = msg ? cJSON_PrintUnformatted(msg) : NULL;
	cJSON_Delete(msg);
	if (text == NULL) {
		LOG_ERR("Mémoire insuffisante pour le message nRF Cloud");
		return -ENOMEM;
	}

	/* Message « confirmable » : nRF Cloud en accuse réception. */
	err = nrf_cloud_coap_json_message_send(text, false, true);
	cJSON_FreeString(text);

	if (err) {
		LOG_ERR("Envoi à nRF Cloud : échec (%d)", err);
		/* La session est peut-être rompue : elle sera rouverte la prochaine fois. */
		net_cloud_invalidate();
	} else {
		LOG_INF("Alerte reçue par nRF Cloud");
	}
	return err;
}

/* Répond à l'application, une seule fois par alerte. */
static void reply_once(struct alert_request *request, const char *error)
{
	if (request->reply_id != ALERT_NO_REPLY) {
		link_reply(request->reply_id, error);
		request->reply_id = ALERT_NO_REPLY;
	}
}

/*
 * Retourne NULL si l'alerte est partie par au moins une voie (nRF Cloud ou
 * SMS), sinon le code d'erreur du protocole.
 */
static const char *run_alert(struct alert_request *request)
{
	const struct text_position *position;
	bool cloud_ok;
	int sent;

	config_get(&cfg);
	if (cfg.contact_count == 0) {
		LOG_WRN("Alerte impossible : aucun contact enregistré");
		return "no_contact";
	}
	if (!net_wait_connected(NETWORK_WAIT)) {
		LOG_WRN("Alerte impossible : pas de réseau mobile");
		return "no_network";
	}

	position = position_get(&position_buf) ? &position_buf : NULL;

	/* nRF Cloud d'abord : c'est rapide. Dès qu'il a reçu l'alerte, elle est
	 * considérée comme partie, sans attendre les SMS, qui peuvent mettre
	 * longtemps à échouer.
	 */
	cloud_ok = send_to_cloud(request->test ? ALERT_KIND_TEST : ALERT_KIND_REAL, position) == 0;
	if (cloud_ok) {
		reply_once(request, NULL);
		ui_set(UI_SUCCESS);
	}

	text_alert_sms(sms_utf8, sizeof(sms_utf8), &cfg, position, request->test);
	sent = send_sms_to_all();
	if (!cloud_ok && sent == 0) {
		return "send_failed";
	}

	return NULL;
}

static void alert_thread(void *p1, void *p2, void *p3)
{
	struct alert_request request;

	while (true) {
		const char *error;

		k_msgq_get(&requests, &request, K_FOREVER);
		LOG_INF("Alerte %s", request.test ? "de test" : "RÉELLE");
		ui_set(UI_ALERTING);

		error = run_alert(&request);
		position_resume();

		ui_set(error == NULL ? UI_SUCCESS : UI_FAILURE);
		reply_once(&request, error);
		atomic_clear(&busy);
	}
}

K_THREAD_DEFINE(alert_tid, 4096, alert_thread, NULL, NULL, NULL, K_PRIO_PREEMPT(7), 0, 0);

int alert_trigger(bool test, int reply_id)
{
	struct alert_request request = {.test = test, .reply_id = reply_id};

	if (!atomic_cas(&busy, 0, 1)) {
		return -EBUSY;
	}
	return k_msgq_put(&requests, &request, K_NO_WAIT);
}

/* Le bijou ne traite pas les SMS reçus, mais le modem refuse d'en envoyer
 * (+CMS ERROR: 301) tant qu'aucun client SMS n'est inscrit.
 */
static void sms_handler(struct sms_data *const data, void *context)
{
	ARG_UNUSED(data);
	ARG_UNUSED(context);
}

int alert_init(void)
{
	int err = sms_register_listener(sms_handler, NULL);

	if (err < 0) {
		LOG_ERR("sms_register_listener: %d", err);
		return err;
	}

	return 0;
}
```

## src/alert.h
```c
/* Déroulement d'une alerte : localisation, puis envoi à nRF Cloud et par SMS. */
#ifndef HESTIA_ALERT_H_
#define HESTIA_ALERT_H_

#include <stdbool.h>

/* Valeur de @p reply_id quand personne n'attend de réponse (appui sur le bouton). */
#define ALERT_NO_REPLY (-1)

int alert_init(void);

/*
 * Lance une alerte. Avec @p test, les SMS indiquent qu'il s'agit d'un essai et
 * le résultat est renvoyé à l'application en réponse à la requête @p reply_id.
 * Retourne -EBUSY si une alerte est déjà en cours.
 */
int alert_trigger(bool test, int reply_id);

#endif /* HESTIA_ALERT_H_ */
```

## src/alert_json.c
```c
#include <math.h>

#include "alert_json.h"

static const char *kind_name(enum alert_kind kind)
{
	return kind == ALERT_KIND_TEST ? "test" : "real";
}

/* Arrondit à 5 décimales (environ 1 m) : inutile d'envoyer 15 chiffres. */
static double round5(double value)
{
	return round(value * 100000.0) / 100000.0;
}

cJSON *alert_json_build(enum alert_kind kind, const struct hestia_config *cfg,
			const struct text_position *position, int battery, int64_t ts_ms)
{
	cJSON *msg = cJSON_CreateObject();
	cJSON *contacts;
	cJSON *data;

	if (msg == NULL || cJSON_AddStringToObject(msg, "appId", ALERT_APP_ID) == NULL ||
	    cJSON_AddStringToObject(msg, "messageType", "DATA") == NULL ||
	    (ts_ms > 0 && cJSON_AddNumberToObject(msg, "ts", (double)ts_ms) == NULL)) {
		goto fail;
	}

	data = cJSON_AddObjectToObject(msg, "data");
	if (data == NULL || cJSON_AddStringToObject(data, "type", kind_name(kind)) == NULL ||
	    cJSON_AddStringToObject(data, "name", cfg->name) == NULL ||
	    cJSON_AddStringToObject(data, "message", cfg->message) == NULL ||
	    (battery >= 0 && cJSON_AddNumberToObject(data, "battery", battery) == NULL)) {
		goto fail;
	}

	/* Seuls les numéros partent : le serveur d'envoi de SMS n'a pas besoin
	 * des noms, et le message doit tenir dans un seul paquet.
	 */
	contacts = cJSON_AddArrayToObject(data, "contacts");
	if (contacts == NULL) {
		goto fail;
	}
	for (int i = 0; i < cfg->contact_count; i++) {
		cJSON *phone = cJSON_CreateString(cfg->contacts[i].phone);

		if (phone == NULL) {
			goto fail;
		}
		cJSON_AddItemToArray(contacts, phone);
	}

	if (position != NULL) {
		cJSON *pos = cJSON_AddObjectToObject(data, "position");

		if (pos == NULL ||
		    cJSON_AddNumberToObject(pos, "lat", round5(position->latitude)) == NULL ||
		    cJSON_AddNumberToObject(pos, "lon", round5(position->longitude)) == NULL ||
		    cJSON_AddNumberToObject(pos, "accuracy",
					    round((double)position->accuracy)) == NULL ||
		    (position->age_s > 0 &&
		     cJSON_AddNumberToObject(pos, "age", position->age_s) == NULL)) {
			goto fail;
		}
	}
	return msg;

fail:
	cJSON_Delete(msg);
	return NULL;
}
```

## src/alert_json.h
```c
/* Message d'alerte envoyé à nRF Cloud. */
#ifndef HESTIA_ALERT_JSON_H_
#define HESTIA_ALERT_JSON_H_

#include <stdint.h>

#include <cJSON.h>

#include "config.h"
#include "text.h"

/* Identifiant des messages Hestia dans nRF Cloud. */
#define ALERT_APP_ID "HESTIA_ALERT"

enum alert_kind {
	/* Appui sur le bouton du bijou. */
	ALERT_KIND_REAL,
	/* Essai lancé depuis l'application. */
	ALERT_KIND_TEST,
};

/*
 * Construit le message au format des messages d'appareil de nRF Cloud :
 *
 *   {"appId":"HESTIA_ALERT","messageType":"DATA","ts":1700000000000,
 *    "data":{"type":"real","name":"…","message":"…","battery":82,
 *            "contacts":["+32470123456"],
 *            "position":{"lat":50.84673,"lon":4.35247,"accuracy":21}}}
 *
 * Si la position vient d'un relevé mis en mémoire, elle porte en plus son âge
 * en secondes : "position":{…,"age":420}.
 *
 * @p position vaut NULL si le bijou n'a pas pu se localiser, @p battery est
 * négatif si le niveau est inconnu et @p ts_ms vaut 0 si l'heure est inconnue :
 * le champ correspondant est alors absent.
 *
 * Retourne NULL s'il n'y a plus de mémoire. L'appelant libère l'objet.
 */
cJSON *alert_json_build(enum alert_kind kind, const struct hestia_config *cfg,
			const struct text_position *position, int battery, int64_t ts_ms);

#endif /* HESTIA_ALERT_JSON_H_ */
```

## src/position.c
```c
#include <errno.h>
#include <string.h>

#include <zephyr/kernel.h>
#include <zephyr/logging/log.h>

#include <modem/location.h>
#include <modem/lte_lc.h>
#include <net/nrf_cloud_coap.h>
#include <net/nrf_cloud_location.h>
#include <net/wifi_location_common.h>

#include "net.h"
#include "position.h"

LOG_MODULE_REGISTER(position, LOG_LEVEL_INF);

/* Relevés Wi-Fi en arrière-plan : le premier peu après le démarrage, puis
 * toutes les 5 minutes. Chacun allume le Wi-Fi quelques secondes, sans rien
 * émettre. Les antennes mobiles ne sont relevées qu'au moment de l'alerte :
 * elle attend de toute façon le réseau mobile pour partir.
 */
#define BACKGROUND_FIRST           K_SECONDS(30)
#define BACKGROUND_PERIOD          K_MINUTES(5)
#define BACKGROUND_SCAN_TIMEOUT_MS (10 * MSEC_PER_SEC)

/* Relevé au moment de l'alerte : il ne doit pas la retarder. */
#define ALERT_SCAN_TIMEOUT_MS (15 * MSEC_PER_SEC)
/* Temps laissé à nRF Cloud pour convertir les relevés, tous essais confondus. */
#define ALERT_RESOLVE_BUDGET_MS (20 * MSEC_PER_SEC)

/* Au-delà de cet âge, des bornes Wi-Fi mémorisées sont moins utiles que les
 * antennes actuelles : la personne a pu se déplacer.
 */
#define STORED_WIFI_MAX_AGE_S (30 * 60)

#define MAX_APS   CONFIG_LOCATION_METHOD_WIFI_SCANNING_RESULTS_MAX_CNT
#define MAX_CELLS CONFIG_LTE_NEIGHBOR_CELLS_MAX

/* Bornes Wi-Fi vues lors d'un relevé. */
struct wifi_record {
	bool valid;
	int64_t time_ms;
	struct wifi_scan_result aps[MAX_APS];
	struct wifi_scan_info info;
};

/* Antennes mobiles vues lors d'un relevé. */
struct cell_record {
	bool valid;
	int64_t time_ms;
	struct lte_lc_ncell neighbors[MAX_CELLS];
	struct lte_lc_cell gci[MAX_CELLS];
	struct lte_lc_cells_info info;
};

/* Dernier relevé Wi-Fi utile. Un relevé sans borne ne remplace pas le précédent. */
static struct wifi_record stored_wifi;
/* Relevés faits au moment de l'alerte. */
static struct wifi_record fresh_wifi;
static struct cell_record fresh_cells;
/* Où ranger le relevé en cours (NULL : pas demandé). */
static struct wifi_record *volatile wifi_target;
static struct cell_record *volatile cells_target;

/* Une seule demande à la bibliothèque de localisation à la fois. */
static K_MUTEX_DEFINE(lock);
static K_SEM_DEFINE(scan_done, 0, 1);
static atomic_t paused;

static void wifi_copy(struct wifi_record *dst, const struct wifi_scan_info *src, int64_t time_ms)
{
	uint16_t cnt = MIN(src->cnt, MAX_APS);

	memcpy(dst->aps, src->ap_info, cnt * sizeof(dst->aps[0]));
	dst->info.ap_info = dst->aps;
	dst->info.cnt = cnt;
	dst->time_ms = time_ms;
	dst->valid = true;
}

static void cells_copy(struct cell_record *dst, const struct lte_lc_cells_info *src,
		       int64_t time_ms)
{
	uint8_t ncells = src->neighbor_cells ? MIN(src->ncells_count, MAX_CELLS) : 0;
	uint8_t gci = src->gci_cells ? MIN(src->gci_cells_count, MAX_CELLS) : 0;

	dst->info.current_cell = src->current_cell;
	memcpy(dst->neighbors, src->neighbor_cells, ncells * sizeof(dst->neighbors[0]));
	dst->info.neighbor_cells = dst->neighbors;
	dst->info.ncells_count = ncells;
	memcpy(dst->gci, src->gci_cells, gci * sizeof(dst->gci[0]));
	dst->info.gci_cells = dst->gci;
	dst->info.gci_cells_count = gci;
	dst->time_ms = time_ms;
	dst->valid = true;
}

static uint32_t age_s(int64_t time_ms)
{
	return (uint32_t)((k_uptime_get() - time_ms) / MSEC_PER_SEC);
}

/*
 * La bibliothèque est en mode « service externe » : elle fait les relevés et
 * nous les confie au lieu de les envoyer elle-même à nRF Cloud. On les range,
 * et c'est position_get() qui décidera de les faire convertir.
 */
static void location_handler(const struct location_event_data *event)
{
	switch (event->id) {
	case LOCATION_EVT_CLOUD_LOCATION_EXT_REQUEST: {
		const struct location_data_cloud *data = &event->cloud_location_request;
		struct wifi_record *wifi = wifi_target;
		struct cell_record *cells = cells_target;
		int64_t now = k_uptime_get();

		if (wifi != NULL && data->wifi_data != NULL) {
			wifi_copy(wifi, data->wifi_data, now);
		}
		if (cells != NULL && data->cell_data != NULL) {
			cells_copy(cells, data->cell_data, now);
		}
		/* Rien n'est envoyé ici : la bibliothèque clôt la demande. */
		location_cloud_location_ext_result_set(LOCATION_EXT_RESULT_UNKNOWN, NULL);
		return;
	}
	case LOCATION_EVT_RESULT_UNKNOWN:
	case LOCATION_EVT_LOCATION:
		break;
	case LOCATION_EVT_TIMEOUT:
		LOG_WRN("Relevé : délai dépassé");
		break;
	case LOCATION_EVT_ERROR:
		/* Aussi quand aucune borne ni antenne n'est visible. */
		LOG_WRN("Relevé : rien trouvé");
		break;
	default:
		/* Événements intermédiaires (démarrage, changement de méthode…). */
		return;
	}
	k_sem_give(&scan_done);
}

/*
 * Relève les bornes Wi-Fi dans @p wifi et, si @p cells n'est pas NULL, les
 * antennes mobiles dans @p cells. Le verrou doit être pris.
 */
static void scan(struct wifi_record *wifi, struct cell_record *cells, int32_t timeout_ms)
{
	struct location_config config;
	/* Wi-Fi et antennes côte à côte : la bibliothèque fait les deux relevés
	 * en même temps et les rend ensemble.
	 */
	enum location_method methods[] = {LOCATION_METHOD_WIFI, LOCATION_METHOD_CELLULAR};
	int err;

	location_config_defaults_set(&config, cells ? ARRAY_SIZE(methods) : 1, methods);
	config.methods[0].wifi.timeout = timeout_ms;
	if (cells != NULL) {
		config.methods[1].cellular.timeout = timeout_ms;
	}
	config.timeout = timeout_ms + 5 * MSEC_PER_SEC;

	wifi_target = wifi;
	cells_target = cells;
	k_sem_reset(&scan_done);

	err = location_request(&config);
	if (err) {
		LOG_ERR("location_request: %d", err);
	} else if (k_sem_take(&scan_done, K_MSEC(config.timeout + 5 * MSEC_PER_SEC)) != 0) {
		LOG_WRN("Relevé sans réponse, annulation");
		(void)location_request_cancel();
	}
	wifi_target = NULL;
	cells_target = NULL;
}

static void background_thread(void *p1, void *p2, void *p3)
{
	k_sleep(BACKGROUND_FIRST);

	while (true) {
		k_mutex_lock(&lock, K_FOREVER);
		if (!atomic_get(&paused)) {
			scan(&stored_wifi, NULL, BACKGROUND_SCAN_TIMEOUT_MS);
			LOG_INF("Relevé en mémoire : %d borne(s) Wi-Fi (il y a %u s)",
				stored_wifi.valid ? stored_wifi.info.cnt : 0,
				stored_wifi.valid ? age_s(stored_wifi.time_ms) : 0);
		}
		k_mutex_unlock(&lock);
		k_sleep(BACKGROUND_PERIOD);
	}
}

K_THREAD_DEFINE(background_tid, 2048, background_thread, NULL, NULL, NULL,
		K_LOWEST_APPLICATION_THREAD_PRIO, 0, SYS_FOREVER_MS);

enum resolve_result {
	RESOLVED,
	/* nRF Cloud ne connaît pas ces bornes ou ces antennes. */
	NOT_FOUND,
	/* nRF Cloud est injoignable : inutile d'essayer d'autres relevés. */
	CLOUD_DOWN,
};

/* Une piste pour trouver la position : un relevé Wi-Fi, ou d'antennes. */
struct attempt {
	struct wifi_record *wifi;
	struct cell_record *cells;
	/* Relevé fait pendant l'alerte : la position est actuelle. */
	bool current;
	const char *what;
};

/* Fait convertir un relevé en coordonnées par nRF Cloud. */
static enum resolve_result resolve(const struct attempt *attempt, struct text_position *out)
{
	struct nrf_cloud_coap_location_request request = {
		.wifi_info = attempt->wifi ? &attempt->wifi->info : NULL,
		.cell_info = attempt->cells ? &attempt->cells->info : NULL,
	};
	struct nrf_cloud_location_result result = {.type = LOCATION_TYPE__INVALID};
	int64_t time_ms = attempt->wifi ? attempt->wifi->time_ms : attempt->cells->time_ms;
	int err = nrf_cloud_coap_location_get(&request, &result);

	if (err < 0 && err != -EINVAL && err != -ENOMEM && err != -E2BIG && err != -ENOBUFS &&
	    err != -EBADMSG) {
		LOG_WRN("%s : nRF Cloud injoignable (%d)", attempt->what, err);
		/* La session est peut-être rompue : elle sera rouverte la prochaine fois. */
		net_cloud_invalidate();
		return CLOUD_DOWN;
	}
	if (err != 0 || result.err != NRF_CLOUD_ERROR_NONE ||
	    result.type == LOCATION_TYPE__INVALID) {
		LOG_WRN("%s : position introuvable (%d)", attempt->what, err);
		return NOT_FOUND;
	}

	out->latitude = result.lat;
	out->longitude = result.lon;
	out->accuracy = (float)result.unc;
	out->age_s = attempt->current ? 0 : age_s(time_ms);
	LOG_INF("Position obtenue par %s (marge %u m, âge %u s)", attempt->what,
		result.unc, out->age_s);
	return RESOLVED;
}

/*
 * Essaie les relevés du plus utile au moins utile, jusqu'à obtenir une
 * position :
 *   1. bornes Wi-Fi actuelles ;
 *   2. bornes Wi-Fi mémorisées, si elles ont moins de 30 minutes ;
 *   3. antennes actuelles ;
 *   4. bornes Wi-Fi mémorisées plus anciennes.
 */
static bool resolve_best(struct text_position *out)
{
	struct attempt attempts[4];
	int count = 0;
	bool stored_wifi_recent =
		stored_wifi.valid && age_s(stored_wifi.time_ms) <= STORED_WIFI_MAX_AGE_S;
	int64_t deadline;

	if (fresh_wifi.valid) {
		attempts[count++] = (struct attempt){
			.wifi = &fresh_wifi, .current = true, .what = "Wi-Fi actuel"};
	}
	if (stored_wifi_recent) {
		attempts[count++] = (struct attempt){
			.wifi = &stored_wifi, .what = "Wi-Fi mémorisé"};
	}
	if (fresh_cells.valid) {
		attempts[count++] = (struct attempt){
			.cells = &fresh_cells, .current = true, .what = "antennes actuelles"};
	}
	if (stored_wifi.valid && !stored_wifi_recent) {
		attempts[count++] = (struct attempt){
			.wifi = &stored_wifi, .what = "ancien Wi-Fi mémorisé"};
	}

	if (count == 0) {
		LOG_WRN("Aucune borne ni antenne relevée");
		return false;
	}
	if (net_cloud_ensure() != 0) {
		return false;
	}

	deadline = k_uptime_get() + ALERT_RESOLVE_BUDGET_MS;
	for (int i = 0; i < count; i++) {
		if (k_uptime_get() > deadline) {
			LOG_WRN("Localisation : délai dépassé");
			break;
		}
		switch (resolve(&attempts[i], out)) {
		case RESOLVED:
			return true;
		case CLOUD_DOWN:
			return false;
		case NOT_FOUND:
			break;
		}
	}
	return false;
}

bool position_get(struct text_position *out)
{
	bool found;

	atomic_set(&paused, 1);

	/* Un relevé en arrière-plan en cours ne doit pas retarder l'alerte. */
	if (k_mutex_lock(&lock, K_NO_WAIT) != 0) {
		LOG_INF("Relevé en arrière-plan interrompu");
		(void)location_request_cancel();
		k_sem_give(&scan_done);
		k_mutex_lock(&lock, K_FOREVER);
	}

	/* Ouvre la session nRF Cloud avant le relevé, pour qu'elle soit prête à
	 * convertir les relevés aussitôt.
	 */
	(void)net_cloud_ensure();

	fresh_wifi.valid = false;
	fresh_cells.valid = false;
	scan(&fresh_wifi, &fresh_cells, ALERT_SCAN_TIMEOUT_MS);

	found = resolve_best(out);

	/* Le relevé Wi-Fi de l'alerte devient le plus récent en mémoire. */
	if (fresh_wifi.valid) {
		wifi_copy(&stored_wifi, &fresh_wifi.info, fresh_wifi.time_ms);
	}

	k_mutex_unlock(&lock);
	return found;
}

void position_resume(void)
{
	atomic_clear(&paused);
}

int position_init(void)
{
	int err = location_init(location_handler);

	if (err) {
		LOG_ERR("location_init: %d", err);
		return err;
	}
	k_thread_start(background_tid);
	return 0;
}
```

## src/position.h
```c
/*
 * Localisation du bijou.
 *
 * Toutes les 5 minutes, le bijou relève les bornes Wi-Fi qui l'entourent et
 * garde ce relevé en mémoire sans rien envoyer. Au moment d'une alerte, il
 * relève les bornes Wi-Fi et les antennes mobiles. Seuls les relevés utiles
 * sont envoyés à nRF Cloud, qui les convertit en coordonnées.
 */
#ifndef HESTIA_POSITION_H_
#define HESTIA_POSITION_H_

#include <stdbool.h>

#include "text.h"

/* Démarre la bibliothèque de localisation et les relevés en arrière-plan. */
int position_init(void);

/*
 * Cherche la position pour une alerte. Les relevés en arrière-plan sont
 * suspendus jusqu'à position_resume().
 *
 * Retourne true si une position est obtenue. Si elle vient d'un relevé ancien,
 * @p out->age_s indique depuis combien de secondes.
 */
bool position_get(struct text_position *out);

/* Reprend les relevés en arrière-plan. */
void position_resume(void);

#endif /* HESTIA_POSITION_H_ */
```

## src/text.c
```c
#include <stdint.h>
#include <stdio.h>
#include <stdlib.h>
#include <string.h>

#include "text.h"

void text_copy_utf8(char *dst, size_t dst_len, const char *src)
{
	size_t len = strlen(src);

	if (len >= dst_len) {
		len = dst_len - 1;
		/* Recule jusqu'au début d'un caractère (les octets 10xxxxxx sont
		 * des octets de suite).
		 */
		while (len > 0 && ((unsigned char)src[len] & 0xC0) == 0x80) {
			len--;
		}
	}
	memcpy(dst, src, len);
	dst[len] = '\0';
}

/* Lit un caractère UTF-8 et avance @p src. Retourne U+FFFD si la séquence est invalide. */
static uint32_t utf8_next(const char **src)
{
	const unsigned char *s = (const unsigned char *)*src;
	uint32_t cp;
	int extra;

	if (s[0] < 0x80) {
		cp = s[0];
		extra = 0;
	} else if ((s[0] & 0xE0) == 0xC0) {
		cp = s[0] & 0x1F;
		extra = 1;
	} else if ((s[0] & 0xF0) == 0xE0) {
		cp = s[0] & 0x0F;
		extra = 2;
	} else if ((s[0] & 0xF8) == 0xF0) {
		cp = s[0] & 0x07;
		extra = 3;
	} else {
		*src += 1;
		return 0xFFFD;
	}

	for (int i = 1; i <= extra; i++) {
		if ((s[i] & 0xC0) != 0x80) {
			*src += i;
			return 0xFFFD;
		}
		cp = (cp << 6) | (s[i] & 0x3F);
	}
	*src += extra + 1;
	return cp;
}

/* Équivalent ISO-8859-15 d'un caractère, ou NULL s'il doit être ignoré. */
static const char *latin9_of(uint32_t cp, char single[2])
{
	single[1] = '\0';

	if (cp < 0x80) {
		single[0] = (char)cp;
		return single;
	}

	switch (cp) {
	/* Caractères dont le code diffère entre Unicode et ISO-8859-15. */
	case 0x20AC: single[0] = (char)0xA4; return single; /* € */
	case 0x0160: single[0] = (char)0xA6; return single; /* Š */
	case 0x0161: single[0] = (char)0xA8; return single; /* š */
	case 0x017D: single[0] = (char)0xB4; return single; /* Ž */
	case 0x017E: single[0] = (char)0xB8; return single; /* ž */
	case 0x0152: single[0] = (char)0xBC; return single; /* Œ */
	case 0x0153: single[0] = (char)0xBD; return single; /* œ */
	case 0x0178: single[0] = (char)0xBE; return single; /* Ÿ */
	/* Ponctuation « intelligente » que les claviers de téléphone insèrent. */
	case 0x2018:
	case 0x2019: return "'";
	case 0x201C:
	case 0x201D: return "\"";
	case 0x2013:
	case 0x2014: return "-";
	case 0x2026: return "...";
	case 0x00A0:
	case 0x202F: return " ";
	/* Sélecteurs de variante et liant des émojis : rien à afficher. */
	case 0x200D:
	case 0xFE0F: return NULL;
	/* Ces positions portent un autre caractère en ISO-8859-15. */
	case 0xA4: case 0xA6: case 0xA8: case 0xB4: case 0xB8:
	case 0xBC: case 0xBD: case 0xBE: return "?";
	default:
		break;
	}

	if (cp >= 0xA1 && cp <= 0xFF) {
		single[0] = (char)cp;
		return single;
	}
	return "?";
}

size_t text_utf8_to_latin9(char *dst, size_t dst_len, const char *src)
{
	size_t len = 0;

	while (*src != '\0') {
		char single[2];
		const char *out = latin9_of(utf8_next(&src), single);
		size_t out_len = out ? strlen(out) : 0;

		if (len + out_len >= dst_len) {
			break;
		}
		memcpy(dst + len, out, out_len);
		len += out_len;
	}
	dst[len] = '\0';
	return len;
}

/*
 * Écrit « 50.84673,4.35247 ». Passe par des entiers pour ne pas dépendre de
 * l'affichage des nombres à virgule de la bibliothèque C.
 */
static int format_coordinates(char *dst, size_t dst_len, const struct text_position *pos)
{
	long lat = (long)(pos->latitude * 100000.0 + (pos->latitude < 0 ? -0.5 : 0.5));
	long lon = (long)(pos->longitude * 100000.0 + (pos->longitude < 0 ? -0.5 : 0.5));

	return snprintf(dst, dst_len, "%s%ld.%05ld,%s%ld.%05ld",
			lat < 0 ? "-" : "", labs(lat) / 100000, labs(lat) % 100000,
			lon < 0 ? "-" : "", labs(lon) / 100000, labs(lon) % 100000);
}

/* Écrit « 7 min », « 1 h 05 » ou « 2 j ». */
static void format_age(char *dst, size_t dst_len, uint32_t age_s)
{
	unsigned long minutes = age_s / 60;

	if (minutes < 1) {
		snprintf(dst, dst_len, "moins d'une minute");
	} else if (minutes < 60) {
		snprintf(dst, dst_len, "%lu min", minutes);
	} else if (minutes < 24 * 60) {
		snprintf(dst, dst_len, "%lu h %02lu", minutes / 60, minutes % 60);
	} else {
		snprintf(dst, dst_len, "%lu j", minutes / (24 * 60));
	}
}

static void append_position(char *dst, size_t dst_len, const struct text_position *pos)
{
	size_t len = strlen(dst);
	char coordinates[32];
	char margin[24];
	char age[24];
	long accuracy = (long)(pos->accuracy + 0.5f);

	format_coordinates(coordinates, sizeof(coordinates), pos);

	if (accuracy >= 1000) {
		snprintf(margin, sizeof(margin), "%ld km", (accuracy + 500) / 1000);
	} else {
		snprintf(margin, sizeof(margin), "%ld m", accuracy < 1 ? 1 : accuracy);
	}

	if (pos->age_s == 0) {
		snprintf(dst + len, dst_len - len,
			 "\nPosition (à environ %s près) : https://maps.google.com/?q=%s",
			 margin, coordinates);
	} else {
		format_age(age, sizeof(age), pos->age_s);
		snprintf(dst + len, dst_len - len,
			 "\nDernière position connue, il y a %s (à environ %s près) : "
			 "https://maps.google.com/?q=%s",
			 age, margin, coordinates);
	}
}

static const char *wearer_name(const struct hestia_config *cfg)
{
	return cfg->name[0] != '\0' ? cfg->name : "Le porteur du bijou";
}

void text_alert_sms(char *dst, size_t dst_len, const struct hestia_config *cfg,
		    const struct text_position *position, bool test)
{
	const char *prefix = test ? "[TEST - pas d'urgence] " : "";

	if (cfg->message[0] != '\0') {
		snprintf(dst, dst_len, "%s%s", prefix, cfg->message);
	} else {
		snprintf(dst, dst_len, "%s%s a appuyé sur son bouton d'urgence et a besoin d'aide.",
			 prefix, wearer_name(cfg));
	}

	if (position != NULL) {
		append_position(dst, dst_len, position);
	} else {
		size_t len = strlen(dst);

		snprintf(dst + len, dst_len - len, "\nPosition inconnue pour le moment.");
	}
}
```

## src/text.h
```c
/* Préparation des textes : troncature UTF-8 et rédaction des SMS. */
#ifndef HESTIA_TEXT_H_
#define HESTIA_TEXT_H_

#include <stdbool.h>
#include <stddef.h>
#include <stdint.h>

#include "config.h"

/* Taille maximale d'un SMS rédigé par le bijou, zéro final compris. */
#define TEXT_SMS_LEN 640

/* Position obtenue par le bijou. */
struct text_position {
	double latitude;
	double longitude;
	/* Marge d'erreur en mètres. */
	float accuracy;
	/* Âge de la position en secondes : 0 si elle est actuelle, sinon elle
	 * vient du dernier relevé mis en mémoire.
	 */
	uint32_t age_s;
};

/*
 * Copie une chaîne UTF-8 en la tronquant si besoin, sans jamais couper un
 * caractère en deux.
 */
void text_copy_utf8(char *dst, size_t dst_len, const char *src);

/*
 * Convertit de l'UTF-8 vers l'ISO-8859-15, seul jeu de caractères accepté par
 * la bibliothèque SMS. Les caractères sans équivalent deviennent « ? ».
 * Retourne la longueur écrite (hors zéro final).
 */
size_t text_utf8_to_latin9(char *dst, size_t dst_len, const char *src);

/*
 * Rédige le SMS d'alerte en UTF-8.
 * @p position vaut NULL si le bijou n'a pas pu se localiser.
 */
void text_alert_sms(char *dst, size_t dst_len, const struct hestia_config *cfg,
		    const struct text_position *position, bool test);

#endif /* HESTIA_TEXT_H_ */
```
